/**
 * *************************************************************************************************************
 * @file Ram.c
 * @author BH_CodeGenerator
 * @version 0.1
 * @date 2022-04-01
 * @warning <!--auto generated by Tools, do not modify or add anything, otherwise, your change will be lost!!! -->
 * @brief all the functions prototypes for Ram firmware library
 * MCU / CFG Ver. :BH66F2475/1.7
 * Version = 1.0.0

 * *************************************************************************************************************
 *  @attention
 *
 *  Firmware Disclaimer Information
 *
 *  1. The customer hereby acknowledges and agrees that the program technical documentation, including the
 *     code, which is supplied by BEST HEALTH ELECTRONIC Inc., (hereinafter referred to as BestHealth) is the
 *     proprietary and confidential intellectual property of BestHealth, and is protected by copyright law and
 *     other intellectual property laws.
 *
 *  2. The customer hereby acknowledges and agrees that the program technical documentation, including the
 *     code, is confidential information belonging to BestHealth, and must not be disclosed to any third parties
 *     other than BestHealth and the customer.
 *
 *  3. The program technical documentation, including the code, is provided and for customer reference
 *     only. After delivery by BestHealth, the customer shall use the program technical documentation, including
 *     the code, at their own risk. BestHealth disclaims any expressed, implied or statutory warranties, including
 *     the warranties of merchantability, satisfactory quality and fitness for a particular purpose.
 *
 *  <h2><center>Copyright (C) BEST HEALTH ELECTRONIC Inc. All rights reserved</center></h2>
 */
/* Define to prevent recursive inclusion -------------------------------------------------------------------*/
#include "Ram.h"
#include "BH66F2455.h"
#define RAM_BANK 4

/**
 * @brief Clear all ram data
 *
 */
void Ram_Clear(void)
{
    _mp1h = 0;
    _mp1l = 0x80;
    while (_mp1h < RAM_BANK)
    {
        for (_tblp = 0x00; _tblp < 128; _tblp++)
        {
            _iar1 = 0;
            _mp1l++;
        }
        _mp1l = 0x80;
        _mp1h++;
    }

    _mp1h = 3;
    _mp1l = 0;
    for (_tblp = 0x00; _tblp < 64; _tblp++)
    {
        _iar1 = 0;
        _mp1l++;
    }
}